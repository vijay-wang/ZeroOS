## Kconfig
```kconfig
mainmenu "Studinix $STUDINIXVERSION Configuration"

config STUDINIXVERSION
	string
	option env="STUDINIXVERSION"

source "arch/Kconfig"

menu "General setup"

config LOCALVERSION
	string "Local version - append to U-Boot release"
	help
	  Append an extra string to the end of your U-Boot version.
	  This will show up on your boot log, for example.
	  The string you set here will be appended after the contents of
	  any files with a filename matching localversion* in your
	  object and source tree, in that order.  Your total string can
	  be a maximum of 64 characters.

config LOCALVERSION_AUTO
	bool "Automatically append version information to the version string"
	default y
	help
	  This will try to automatically determine if the current tree is a
	  release tree by looking for git tags that belong to the current
	  top of tree revision.

	  A string of the format -gxxxxxxxx will be added to the localversion
	  if a git-based tree is found.  The string generated by this will be
	  appended after any matching localversion* files, and after the value
	  set in CONFIG_LOCALVERSION.

	  (The actual string used here is the first eight characters produced
	  by running the command:

	    $ git rev-parse --verify HEAD

	  which is done within the script "scripts/setlocalversion".)

endmenu		# General setup
```

## arch/Kconfig
```kconfig
choice
	prompt "Architecture select"
	default SANDBOX

config ARM
	bool "ARM architecture"
	select CREATE_ARCH_SYMLINK
	select HAVE_PRIVATE_LIBGCC if !ARM64
	select HAVE_GENERIC_BOARD
	select SYS_GENERIC_BOARD
	select SUPPORT_OF_CONTROL

config X86
	bool "x86 architecture"
	select CREATE_ARCH_SYMLINK
	select HAVE_PRIVATE_LIBGCC
	select HAVE_GENERIC_BOARD
	select SYS_GENERIC_BOARD
	select SUPPORT_OF_CONTROL
	select DM
	select DM_SERIAL
	select DM_GPIO
	select DM_SPI
	select DM_SPI_FLASH

config SANDBOX
	bool "Sandbox"
	select HAVE_GENERIC_BOARD
	select SYS_GENERIC_BOARD
	select SUPPORT_OF_CONTROL
	select DM
	select DM_SPI_FLASH
	select DM_SERIAL
	select DM_I2C
	select DM_SPI
	select DM_GPIO

endchoice

config SYS_ARCH
	string
	help
	  This option should contain the architecture name to build the
	  appropriate arch/<CONFIG_SYS_ARCH> directory.
	  All the architectures should specify this option correctly.

config SYS_CPU
	string
	help
	  This option should contain the CPU name to build the correct
	  arch/<CONFIG_SYS_ARCH>/cpu/<CONFIG_SYS_CPU> directory.

	  This is optional.  For those targets without the CPU directory,
	  leave this option empty.

source "arch/arm/Kconfig"
```

## arch/arm/Kconfig
```kconfig
menu "ARM architecture"
	depends on ARM

config SYS_ARCH
	default "arm"

choice
	prompt "Target select"
        default CPU_V7

config CPU_V7
        bool "armv7"
        select HAS_VBAR
        select HAS_THUMB2

config CPU_V7M
	bool "armv7m"
        select HAS_THUMB2

endchoice

config SYS_CPU
        default "armv7" if CPU_V7
        default "armv7m" if CPU_V7M

#source "arch/arm/cpu/armv7/mx7/Kconfig"

#source "arch/arm/mach-zynq/Kconfig"

source "arch/arm/cpu/armv7/Kconfig"

#source "board/BuR/kwb/Kconfig"

endmenu
```
